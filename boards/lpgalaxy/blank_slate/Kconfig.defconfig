## boards/lpgalaxy/blank_slate/Kconfig.defconfig
```kconfig
# Copyright (c) 2020 Pete Johanson
# SPDX-License-Identifier: MIT

if BOARD_BLANK_SLATE

config ZMK_KEYBOARD_NAME
	default "<<ANGEL SLATE>>"

if USB

config USB_NRFX
	default y

config USB_DEVICE_STACK
	default y

endif # USB

# config BT_CTLR
# 	default BT

config ZMK_BLE_CLEAR_BONDS_ON_START
	default n
config ZMK_SETTINGS_RESET_ON_START
	default n

config ZMK_BLE
	default y

config ZMK_PM_SOFT_OFF
	default n
config ZMK_SLEEP
	default y

config ZMK_USB
	default y

config ZMK_STUDIO
	default n

endif # BOARD_BLANK_SLATE
```
